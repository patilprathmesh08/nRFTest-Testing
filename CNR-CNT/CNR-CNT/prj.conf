## Kconfig
```
#
# Copyright (c) 2022 Nordic Semiconductor
#
# SPDX-License-Identifier: LicenseRef-Nordic-5-Clause
#

source "Kconfig.zephyr"

menu "Nordic Sta sample"

config CONNECTION_IDLE_TIMEOUT
	int "Time to be waited for a station to connect"
	default 30

config NRF70_QSPI_ENCRYPTION_KEY
	string "16 bytes QSPI encryption key, only for testing purposes"
	depends on BOARD_NRF7002DK_NRF5340_CPUAPP
	help
	  Specify the QSPI encryption key

config STA_CONN_TIMEOUT_SEC
	int "Overall Connection timeout i.e., time to be waited for a station to connect and get an IP address"
	# Zephyr DHCP retry is 1 minute, so set the default to 70 seconds
	default 70
	# 512 has no special meaning, just a reasonable upper limit
	range 0 512
	help
	  Specify the connection timeout, in seconds. This is the overall timeout i.e., time to be waited for
	  a station to connect and get an IP address. DHCP retries should be taken into account when setting
	  this value. If the timeout is set to 0, the connection will not timeout.

config STA_SAMPLE_START_WIFI_THREAD_STACK_SIZE
	int "Stack size for Wi-Fi start thread"
	default 4096
	help
	  Set the stack size for the Wi-Fi start thread.

config WIFI_SURVEY_SCAN
	bool "Log a full dual-band Wi-Fi scan before connecting"
	default n
	help
	  Runs a scan across every band and channel the regulatory domain
	  allows, immediately BEFORE the association attempt, and logs each
	  AP found with its band, channel, RSSI and security. It then states
	  explicitly whether the configured SSID was among them.

	  Purpose: turn a bare "Connection failed (4)"
	  (WIFI_STATUS_CONN_AP_NOT_FOUND) into a definite answer. Either the
	  SSID is not on the air - wrong name, radio disabled on the router,
	  or a channel the regulatory domain forbids - or it IS visible and
	  the fault lies in the association itself. Those have completely
	  different fixes.

	  The nRF7002 is dual-band, so it is often the ONLY instrument that
	  can see a 5 GHz network: a 2.4 GHz-only laptop adapter cannot
	  confirm or deny that such an SSID exists.

	  Runs before the connect, so the survey is in the log even when the
	  connection then fails - which is the case it exists for.

	  Costs up to WIFI_SCAN_WAIT_MAX_MS (20 s) of extra boot time and a
	  burst of UART traffic, so leave this DISABLED in a production
	  build. Scan failure is non-fatal: the board still attempts the
	  connection it was configured for.

choice SEND_TRIGGER
	prompt "When to send frames"
	default SEND_TRIGGER_CONTINUOUS
	help
	  Chooses what causes a frame to be built and transmitted. All three
	  options are kept compiled-out alternatives of each other, so
	  switching is a one-line prj.conf change with no source edits.

config SEND_TRIGGER_CONTINUOUS
	bool "Continuously, every sampler period"
	help
	  Once setup completes the board streams
	  a frame every sampler period, forever. src/button.c is not
	  compiled in at all.

config SEND_TRIGGER_BUTTON_HOLD
	bool "Only while DK Button 1 is held down"
	help
	  The sampler keeps ticking, but a frame is only built and sent
	  while the button is physically held. Releasing it
	  stops the stream immediately - the board goes silent rather than
	  sending stale or zeroed frames.

config SEND_TRIGGER_BUTTON_PRESS
	bool "One frame per DK Button 1 press"
	help
	  Each debounced press of the button builds and sends EXACTLY ONE
	  frame. Holding the button down does not repeat -
	  only the rising edge counts, so a long press still sends one
	  frame. Release and press again for the next.

	  This is the mode to use for stepping through a recorded
	  trajectory by hand, one sample at a time.

endchoice

config SEND_TRIGGER_NEEDS_BUTTON
	bool
	default y if SEND_TRIGGER_BUTTON_HOLD || SEND_TRIGGER_BUTTON_PRESS
	help
	  Internal, not user-settable. Single symbol for "this build needs
	  src/button.c", so CMakeLists.txt does not have to test both button
	  modes and cannot fall out of sync when a mode is added.

	  Which button: the DK's silkscreen "Button 1" is devicetree alias
	  sw0, node button0, P1.08 - NOT the node named button1, which is
	  the second button on the board.

	  Interaction with DEBUG_TFLITE: the replay row only advances when a
	  frame is actually built, so either button mode PAUSES the recorded
	  trajectory rather than skipping through it. The pass stays complete
	  and in order across any number of presses, but it is no longer
	  evenly spaced in time, which invalidates the filtered-output
	  comparison described in src/replay_data.h. Use SEND_TRIGGER_CONTINUOUS
	  for that comparison.

	  Costs one GPIO read per tick and no RAM worth counting, which
	  matters because RAM sits at roughly 98.4 % on this application.

config DEBUG_TFLITE
	bool "Replay recorded joystick data instead of reading the live ADC"
	default n
	help
	  Feed frame_build() from the recorded trajectory in
	  src/replay_data.c (generated from the customer harness's
	  controller_data_log.csv, columns joystick_x and joystick_y)
	  instead of from the joystick ADC. The JSON frame is byte-for-byte
	  the same shape either way - only where the two joystick values
	  come from changes - so the consumer and the downstream TFLite
	  pipeline need no modification.

	  Purpose: give the TFLite model a known, repeatable input so its
	  output can be checked against the harness's reference
	  motor_commands_output.csv. Read the pacing caveat at the top of
	  src/replay_data.h before doing that comparison - it is not
	  valid at every replay rate.

	  The table is const, so it costs about 13.8 KB of FLASH and ZERO
	  RAM. That matters: RAM on this application sits at roughly 98.3 %.

	  Leave this disabled for normal operation.

if DEBUG_TFLITE

config DEBUG_TFLITE_LOOP
	bool "Wrap to the first sample when the trajectory ends"
	default y
	help
	  When the last recorded sample has been sent, start again from
	  row 0 instead of holding the final value. Convenient for a soak
	  test that needs no intervention.

	  Be aware the wrap is a step discontinuity: the last row is
	  followed immediately by the first, which is not a smooth return
	  to centre. The harness's motion-based anchor logic sees that as
	  one large jump, so discard the frames either side of a seam when
	  comparing against the reference output.

	  Disable to freeze on the last sample instead, which gives a
	  clean single pass.

config DEBUG_TFLITE_PERIOD_MS
	int "Sampler and send period while replaying (ms)"
	default 1000
	range 10 60000
	help
	  Overrides SEND_PERIOD_MS in src/main.c for replay builds only.

	  The default 1000 ms preserves the firmware's normal 1 Hz cadence,
	  which means a full 1151-row pass takes about 19 minutes. The log
	  was actually recorded at about 40 Hz, so set this to 25 to replay
	  at the original rate - required if you intend to compare the
	  harness's FILTERED motor output against its reference, because
	  CascadedEMA is time-constant based.

	  CAUTION: 25 ms is 40x the default traffic over TLS and has not
	  been tested on this board. Raise it if frames are dropped.

endif # DEBUG_TFLITE

endmenu
```

## prj.conf
```kconfig
CONFIG_WIFI=y
CONFIG_WIFI_NRF70=y
CONFIG_POWEROFF=y
CONFIG_HWINFO=y
# WPA supplicant
CONFIG_WIFI_NM_WPA_SUPPLICANT=y
CONFIG_WIFI_READY_LIB=y
CONFIG_NRF_WIFI_RPU_RECOVERY=n
CONFIG_NRF_WIFI_LOW_POWER=n
CONFIG_LOG_MODE_IMMEDIATE=n
CONFIG_MBEDTLS_MEMORY_DEBUG=n
CONFIG_SNTP=y
CONFIG_PM=n
CONFIG_PM_DEVICE=n
CONFIG_WIFI_CREDENTIALS=y
CONFIG_WIFI_CREDENTIALS_STATIC=y

# ---------------- Wi-Fi network ----------------
# The SSID below is the one the router actually BROADCASTS. Note it is NOT
# the "TP-Link_A078_5G" printed on the router label: that name is never on
# the air, because the router (TP-Link Archer AX12, AX1500 Wi-Fi 6, region
# IN/1.8) has SMART CONNECT / band steering enabled, which merges both
# radios under a SINGLE SSID. A dual-band scan from the board shows:
#
#   TP-Link_A078   2.4GHz  ch10    -24 dBm  WPA2-PSK
#   TP-Link_A078   5GHz    ch149   -32 dBm  WPA2-PSK   <-- the 5 GHz radio
#
# and no "_5G" SSID anywhere. Configuring the label name gives
# WIFI_STATUS_CONN_AP_NOT_FOUND (status 4) forever, since no such network
# exists to associate with.
#
# So the SSID below is the same string a 2.4 GHz client would use, but this
# build still lands on 5 GHz: src/wifi_net.c pins
# params.band = WIFI_FREQ_BAND_5_GHZ, which steers the association to the
# 5 GHz radio of that shared SSID. DO NOT read the SSID as meaning 2.4 GHz.
# If you ever point this at a 2.4 GHz-only SSID you MUST change that band
# too, or the board scans the wrong band forever and looks like a dead
# network.
#
# Channel 149 is UNII-3, NOT a DFS channel, so there is no radar-scan delay
# and no DFS association restriction to worry about - one less variable.
# CONFIG_WIFI_CREDENTIALS_STATIC_SSID="TP-Link_A078"
# CONFIG_WIFI_CREDENTIALS_STATIC_PASSWORD="55697521"

# Alternatives, kept for reference. NOTE: the first is 2.4 GHz and needs
# the band change in src/wifi_net.c described above.
# CONFIG_WIFI_CREDENTIALS_STATIC_SSID="TP-Link_A078"
# CONFIG_WIFI_CREDENTIALS_STATIC_PASSWORD="55697521"
CONFIG_WIFI_CREDENTIALS_STATIC_SSID="Pinetics Deco"
CONFIG_WIFI_CREDENTIALS_STATIC_PASSWORD="Pinetics@135"

# Regulatory domain. MUST be set for 5 GHz to work: under the default "00"
# (world/generic) the nRF70 treats most 5 GHz channels as passive-scan-only
# and will NOT associate on them, regardless of the SSID. "IN" enables the
# channels permitted in India, matching the router's IN/1.8 region.
#
# CONFIG_NRF_WIFI_ALL_BAND=y comes from the nRF70 driver defaults, so the
# hardware side needs no change; the reg domain is the only gate.
CONFIG_NRF70_REG_DOMAIN="IN"

CONFIG_WIFI_CREDENTIALS_STATIC_TYPE_PSK=y
CONFIG_POSIX_API=y
CONFIG_POSIX_TIMERS=y
CONFIG_JSON_LIBRARY=y
CONFIG_HTTP_CLIENT=y
CONFIG_BT=n

CONFIG_CONSOLE=y
CONFIG_SERIAL=y
CONFIG_LOG=y
# Log level 3 = INFO. Full logging: boot progress, "Connected", "DHCP
# bound", "NTP sync OK", "TLS connected" and the two per-frame lines.
#
# THE SEND RATE AND THIS SETTING ARE COUPLED - check the arithmetic before
# raising either. The sender emits about 230 bytes per frame and the
# console is 115200 8N1 = 11520 B/s, so with CONFIG_LOG_MODE_IMMEDIATE=y
# (which shifts those bytes out synchronously, in the calling thread):
#
#     rate     UART load     console utilisation
#      10 Hz    2300 B/s      20 %   <- current, comfortable
#      50 Hz   11500 B/s      99.8 % <- saturated; send times balloon
#     100 Hz   23000 B/s     200 %   <- impossible, 2x oversubscribed
#
# At saturation the UART, not the radio, becomes the bottleneck and
# ws_send_frame() blocks for hundreds of milliseconds. If you need a
# faster rate than this, first raise the console baud, drop
# CONFIG_LOG_MODE_IMMEDIATE, or log every Nth frame.
#
# Set to 2 (warnings and errors only) to take the console off the critical
# path entirely - but note a healthy board then looks identical to a hung
# one, so diagnosis moves to SWD.
CONFIG_LOG_DEFAULT_LEVEL=3
CONFIG_ADC=y

CONFIG_LOG_MODE_IMMEDIATE=y
CONFIG_SYS_CLOCK_TICKS_PER_SEC=32768
CONFIG_NEWLIB_LIBC=y
CONFIG_NEWLIB_LIBC_NANO=n
CONFIG_ENTROPY_GENERATOR=y
CONFIG_POSIX_TIMERS=y

CONFIG_NETWORKING=y
CONFIG_NET_SOCKETS=y
CONFIG_NET_LOG=y
CONFIG_NET_IPV4=y
CONFIG_NET_IPV6=n
CONFIG_NET_TCP=y
CONFIG_NET_DHCPV4=y
# ---------------- mDNS (.local) name resolution ----------------
# The WSS/NTP host is an i.MX8MP running Avahi and is reached by its
# mDNS name "verdin-imx8mp.local" (see WSS_HOST in src/https_conn.c)
# instead of a hardcoded IP, so a DHCP address change on that box does
# not need a firmware rebuild.
#
# DNS_RESOLVER is needed even though there is no unicast DNS server here:
# Zephyr routes .local queries through the same resolver, just to the mDNS
# multicast address instead of a DNS server.
CONFIG_DNS_RESOLVER=y
CONFIG_MDNS_RESOLVER=y

# NOT optional despite both DNS_SERVERn strings below being left empty.
# zephyr/subsys/net/lib/dns/resolve.c:dns_resolve_init_default() only
# builds a server list - and therefore only registers the 224.0.0.251:5353
# mDNS pseudo-server - inside #if defined(CONFIG_DNS_SERVER_IP_ADDRESSES).
# With this =n the resolver initialises with zero servers and every
# .local lookup fails with EAI_FAIL. The empty CONFIG_DNS_SERVER1 slot is
# skipped harmlessly ("Empty server name", resolve.c:626).
CONFIG_DNS_SERVER_IP_ADDRESSES=y

# Required to actually RECEIVE the reply. dns_postprocess_server() joins
# the 224.0.0.251 group via net_ipv4_igmp_join(); without IGMP that call
# returns -ENOTSUP, the group is never added to the interface, and
# Avahi's multicast response is dropped by the IP stack.
CONFIG_NET_IPV4_IGMP=y

# One DNS query at a time is all this application ever issues.
CONFIG_DNS_RESOLVER_MAX_SERVERS=1
CONFIG_DNS_NUM_CONCUR_QUERIES=1
# Per-attempt timeout. Kept at the Zephyr default and named explicitly
# because https_conn.c's 5 s retry cadence is measured from the START of
# an attempt, so this value is part of that budget (see RESOLVE_RETRY_MS).
CONFIG_NET_SOCKETS_DNS_TIMEOUT=2000
CONFIG_CBPRINTF_FP_SUPPORT=y
CONFIG_NET_PKT_RX_COUNT=24
CONFIG_NET_PKT_TX_COUNT=80
CONFIG_NET_BUF_RX_COUNT=48
CONFIG_NET_BUF_TX_COUNT=160
CONFIG_HEAP_MEM_POOL_SIZE=131072
CONFIG_NET_TC_TX_COUNT=1

CONFIG_NET_IF_UNICAST_IPV4_ADDR_COUNT=1
CONFIG_NET_MAX_CONTEXTS=5

# ---------------- Network connection contexts ----------------
# MUST be raised above the Zephyr default of 4, which is one short and
# makes EVERY periodic NTP resync fail with:
#     <err> net_conn: Not enough connection contexts.
#     <err> net_sntp: Cannot connect to UDP remote : 2
#     <err> epoch: NTP sync with verdin-imx8mp.local failed (-2)
#
# The handler budget at 4:
#     DHCPv4 client (UDP :68)              1  permanent
#     mDNS resolver (224.0.0.251:5353)     1  permanent
#     TLS/TCP socket to the Verdin         1  permanent once connected
#     ------------------------------------------------------------
#     free                                 1
# but an SNTP resync needs TWO at once - one to resolve the .local name
# and one for the UDP socket to the NTP server itself.
#
# The symptom is deceptive: the BOOT sync works and only the resyncs fail.
# epoch_sync_now() runs BEFORE https_conn_open() in main(), so at boot the
# TCP handler is not taken yet and 2 are free. Once TLS connects, only 1
# ever is. The giveaway in the log is the failure spacing - exactly
# NTP_RESYNC_INTERVAL_S apart.
#
# It fails silently in the data rather than stopping anything: left at
# epoch-0 the board reports utc=[1970-01-01 ...] in every frame.
#
# Set to 8 rather than the strictly-needed 5: a reconnect can register the
# new TCP handler before the old one is released, which is precisely when
# this would bite again. MEASURED cost is 64 bytes of RAM per handler, so
# the extra headroom is 256 B - which matters at ~98.4 % RAM. FLASH is
# unchanged.
CONFIG_NET_MAX_CONN=8
CONFIG_NET_CONTEXT_SYNC_RECV=y

CONFIG_NET_L2_ETHERNET=y
CONFIG_NET_CONFIG_SETTINGS=y
CONFIG_NET_CONFIG_INIT_TIMEOUT=0
CONFIG_NET_SOCKETS_POLL_MAX=6

# The board gets its address via DHCP (CONFIG_NET_DHCPV4 above) rather than
# a static IP - the commented-out lines below are kept only as a fallback
# reference in case a deployment ever needs a fixed address again; if so,
# it MUST match whatever network the board is actually joining.


# CONFIG_NET_CONFIG_MY_IPV4_ADDR="192.168.0.230"
# CONFIG_NET_CONFIG_MY_IPV4_NETMASK="255.255.255.0"
# CONFIG_NET_CONFIG_MY_IPV4_GW="192.168.0.1"


# CONFIG_NET_CONFIG_MY_IPV4_ADDR="192.168.40.230"
# CONFIG_NET_CONFIG_MY_IPV4_NETMASK="255.255.255.0"
# CONFIG_NET_CONFIG_MY_IPV4_GW="192.168.40.1"

CONFIG_NET_MGMT_EVENT_QUEUE_TIMEOUT=5000



CONFIG_MAIN_STACK_SIZE=6144
CONFIG_SYSTEM_WORKQUEUE_STACK_SIZE=2048
CONFIG_NET_TX_STACK_SIZE=4096
CONFIG_NET_RX_STACK_SIZE=4096

CONFIG_SHELL_CMDS_RESIZE=n

CONFIG_MBEDTLS=y
CONFIG_MBEDTLS_ENABLE_HEAP=y
# mTLS client-cert auth means the board also does an ECDSA SIGN operation
# during handshake (proving it owns client_private_key), not just verifying
# the server's cert - this needs more MPI scratch space than a smaller heap
# provides (too small shows as "TLS handshake error: -0x10" /
# MBEDTLS_ERR_MPI_ALLOC_FAILED).
CONFIG_MBEDTLS_HEAP_SIZE=65536
CONFIG_MBEDTLS_PEM_PARSE_C=y

# CONFIG_NRF_SECURITY and CONFIG_MBEDTLS_TLS_LIBRARY are intentionally not
# set directly here - NCS v3.4.0's Mbed TLS 4.x / TF-PSA-Crypto makes both
# derived-only symbols with no prompt, so assigning them is a hard CMake
# Kconfig error. CONFIG_MBEDTLS_LEGACY_CRYPTO_C, CONFIG_MBEDTLS_ECDH_C,
# CONFIG_MBEDTLS_USE_PSA_CRYPTO, and CONFIG_MBEDTLS_KEY_EXCHANGE_ECDH_ECDSA_ENABLED
# no longer exist as symbols at all in this NCS version. Everything they
# used to enable is still pulled in automatically by NET_SOCKETS_SOCKOPT_TLS
# and the PSA_WANT_* selections below.
CONFIG_MBEDTLS_ECP_C=y
CONFIG_MBEDTLS_ECDSA_C=y
CONFIG_NET_SOCKETS_SOCKOPT_TLS=y
CONFIG_TLS_CREDENTIALS=y
CONFIG_NET_SOCKETS_TLS_MAX_CONTEXTS=2
# Board provisions only client cert + client private key - no CA cert, so
# it does not verify server identity.
CONFIG_NET_SOCKETS_TLS_MAX_CREDENTIALS=2

CONFIG_MBEDTLS_X509_CRT_PARSE_C=y
CONFIG_MBEDTLS_PK_C=y

CONFIG_PSA_WANT_ALG_ECDH=y
CONFIG_PSA_WANT_ALG_ECDSA=y
CONFIG_PSA_WANT_ECC_SECP_R1_256=y
CONFIG_PSA_WANT_ALG_SHA_256=y
CONFIG_PSA_WANT_ALG_GCM=y
CONFIG_PSA_WANT_KEY_TYPE_AES=y
CONFIG_MBEDTLS_KEY_EXCHANGE_ECDHE_ECDSA_ENABLED=y

CONFIG_PSA_WANT_KEY_TYPE_ECC_KEY_PAIR_IMPORT=y
CONFIG_PSA_WANT_KEY_TYPE_ECC_PUBLIC_KEY=y
CONFIG_POSIX_API=y

CONFIG_PSA_WANT_KEY_TYPE_ECC_KEY_PAIR_IMPORT=y
CONFIG_PSA_WANT_KEY_TYPE_ECC_PUBLIC_KEY=y
CONFIG_POSIX_API=y
# ---------------- TFLite replay ----------------
# Replays the customer harness's recorded joystick trajectory
# (controller_data_log.csv columns joystick_x / joystick_y, 1151 rows)
# in place of the live ADC, so the downstream TFLite model gets a known,
# repeatable input. The JSON frame keeps exactly the same 13 fields.
#
# DISABLED (08-10-2026) so the board sends LIVE joystick ADC readings to the
# base station. Uncomment the line below to go back to replaying the
# recorded trajectory; replay_data.c is then compiled in again (see
# target_sources_ifdef in CMakeLists.txt).
#
# Costs about 13.8 KB of FLASH and ZERO RAM - deliberate, because RAM is
# at roughly 98.3 % with only ~7.4 KB free.
# CONFIG_DEBUG_TFLITE=y

# Wrap to row 0 after the last sample rather than freezing on it, so a
# soak test runs unattended. Set to n for a single clean pass. Note the
# wrap is a step discontinuity in the trajectory - discard the frames
# either side of the seam when comparing against reference output.
CONFIG_DEBUG_TFLITE_LOOP=y

# Sampler/send period while replaying. 100 ms = 10 Hz. One full 1151-row
# pass takes about 115 s at this rate.
#
# THIS RATE MATCHES NEITHER REFERENCE, so do not use it for a filtered
# output comparison:
#   - The harness's example.py assumes CONTROL_TS = 0.02 s (50 Hz), which
#     is the filter time constant its reference output was produced with.
#     Set 20 here to line up with that.
#   - The recording itself averages 24.97 ms between samples (about
#     40 Hz), with wide jitter from 0.36 ms to 52.74 ms. Set 25 here to
#     approximate the real spacing.
# The model's INPUT window is unaffected either way - see the pacing
# caveat in src/replay_data.h for why.
#
# CONSOLE BUDGET: at 10 Hz the sender's ~230 bytes per frame cost
# 2300 B/s of a 11520 B/s console, i.e. 20 % utilisation - comfortable,
# and the reason full INFO logging is viable at this rate. See the table
# under CONFIG_LOG_DEFAULT_LEVEL before raising this: 50 Hz saturates the
# console and 100 Hz is twice oversubscribed.
CONFIG_DEBUG_TFLITE_PERIOD_MS=100

# ---------------- Send trigger ----------------
# The SEND_TRIGGER choice in Kconfig keeps all three behaviours available
# as compiled-out alternatives, switchable from this file alone:
#
#   CONFIG_SEND_TRIGGER_CONTINUOUS=y    stream every sampler period
#   CONFIG_SEND_TRIGGER_BUTTON_HOLD=y   stream only while held
#   CONFIG_SEND_TRIGGER_BUTTON_PRESS=y  ONE frame per press
#
# Exactly one may be set; it is a Kconfig choice, so setting a second is a
# build error rather than a silent surprise. With CONTINUOUS selected,
# src/button.c is not compiled in at all (see CMakeLists.txt).
#
# SELECTED: one frame per press. Each debounced press of the DK's
# silkscreen "Button 1" sends exactly one frame. HOLDING the button does
# NOT repeat - only the rising edge counts - so release and press again
# for the next frame.
#
# NOTE the button numbering trap: the DT node NAMED button1 is silkscreen
# "Button 2". This uses sw0 / button0, which is silkscreen "Button 1".
#
# NOTE for replay comparisons: a press advances the recorded trajectory by
# exactly one row, so the pass stays complete and in order - but it is no
# longer evenly spaced in time. Use CONFIG_SEND_TRIGGER_CONTINUOUS when
# comparing filtered model output against the harness reference
# (see src/replay_data.h).
# SELECTED: continuous. A "frame send frequency" only exists in this mode
# - under BUTTON_PRESS the rate is however fast someone presses the
# button, and CONFIG_DEBUG_TFLITE_PERIOD_MS only governs button polling.
# Switch the line below to CONFIG_SEND_TRIGGER_BUTTON_PRESS=y to go back
# to one-frame-per-press.
CONFIG_SEND_TRIGGER_CONTINUOUS=y

# ---------------- Wi-Fi survey scan ----------------
# Diagnostic. Logs every AP the nRF7002 can see - band, channel, RSSI,
# security - immediately before the association attempt, and says whether
# the configured SSID was among them.
#
# Turn this on whenever association fails with Connection failed (4),
# i.e. WIFI_STATUS_CONN_AP_NOT_FOUND: it distinguishes "that SSID is not
# on the air" from "it is there and association itself failed". The
# nRF7002 is dual-band and is often the only instrument to hand that can
# see a 5 GHz network at all.
#
# TURN THIS OFF once the network question is settled: it costs up to 20 s
# of boot time and a burst of UART traffic on an already-saturated console.
# DISABLED - it has done its job and costs up to 20 s of boot delay.
# Re-enable when a Wi-Fi association problem needs investigating; its AP
# table is logged with LOG_INF, so CONFIG_LOG_DEFAULT_LEVEL must be 3.
# CONFIG_WIFI_SURVEY_SCAN=y
```

## src/main.c
```c
#include <zephyr/logging/log.h>
LOG_MODULE_REGISTER(sta, CONFIG_LOG_DEFAULT_LEVEL);

#include <nrfx_clock.h>
#include <zephyr/kernel.h>
#include <string.h>

#include "button_inputs.h"
#include "epoch.h"
#include "frame.h"
#include "https_conn.h"
#include "joystick.h"
#include "led.h"
#ifdef CONFIG_SEND_TRIGGER_NEEDS_BUTTON
#include "button.h"
#endif
#include "wifi_net.h"

/* Drives both the sampler timer and the send cadence - the two-thread
 * architecture, ADC reads, and frame building all key off it, so nothing
 * else needs adjusting to change the rate. */
#ifdef CONFIG_DEBUG_TFLITE
/* Replay builds take the period from Kconfig so the recorded 40 Hz rate
 * can be reproduced (CONFIG_DEBUG_TFLITE_PERIOD_MS=25) without editing
 * source. Defaults to the same 1000 ms as a normal build, which means one
 * full 1151-row pass takes about 19 minutes - see the pacing caveat in
 * src/replay_data.h for when that matters and when it does not. */
#define SEND_PERIOD_MS      CONFIG_DEBUG_TFLITE_PERIOD_MS
#else
#define SEND_PERIOD_MS      100
#endif

/* NTP_SERVER points at the local ntp_server.py running on the same PC as
 * the WebSocket server, so the board doesn't depend on internet
 * reachability for time sync. Independent of the WSS server address
 * (WSS_HOST/WSS_PORT in src/https_conn.c) on purpose - they happen to be
 * the same PC in this deployment, but that's not a requirement. */
// #define NTP_SERVER   "192.168.40.132"
// #define NTP_SERVER   "192.168.40.95"   /* stale - the Verdin moved off .95 */
#define NTP_SERVER   "192.168.40.100"
/* The same mDNS name the WSS connection uses (WSS_HOST in
 * src/https_conn.c), so both follow the i.MX8MP across DHCP changes. A
 * hardcoded IP here goes stale silently: NTP just fails and CLOCK_REALTIME
 * sits at epoch 0 (1970), which shows up as a 1970 date in every frame
 * rather than as an obvious error.
 *
 * This needs no resolution code here: sntp_simple() - which is all
 * epoch_sync_now() calls, see src/epoch.c - passes its server argument
 * straight to net_getaddrinfo_addr_str()
 * (zephyr/subsys/net/lib/sntp/sntp_simple.c:86), so it resolves names
 * itself. The mDNS Kconfig that makes ".local" resolvable is documented in
 * prj.conf under "mDNS (.local) name resolution".
 *
 * DIFFERENCE FROM THE WSS PATH, deliberate: a failed NTP sync is NOT
 * retried every 5 s like https_conn_open() retries the connection. NTP
 * failure is already non-fatal here (main() logs a warning and carries on),
 * and the resync thread started below re-queries every
 * NTP_RESYNC_INTERVAL_S anyway, which is the existing recovery path. */

/* How often the epoch module re-queries NTP after the initial boot-time
 * sync, to correct for local oscillator drift over long (hours/days) runs.
 *
 * NTP_SERVER is a local/private server on the same network, not a public
 * one, so there's no politeness floor to respect (RFC guidance against
 * hammering public NTP servers doesn't apply here).
 *
 * The resync runs on its own thread (started via epoch_start_resync() in
 * main(), see src/epoch.c) at NTP_RESYNC_PRIORITY below - not on the
 * sampler or sender thread - so it never affects the sampling cadence. */
/* This is a private NTP server on the same LAN, so the politeness floor
 * that applies to public pools does not apply - the interval is chosen
 * purely to bound how long CLOCK_REALTIME can stay wrong after a
 * transient failure.
 *
 * FLOOR: do not shorten this below about 6 s. A FAILING sync blocks the
 * resync thread for up to NTP_SYNC_TIMEOUT_MS (5000, src/epoch.c), so a
 * shorter interval would have one attempt still in progress when the next
 * is due. Even at that floor nothing else suffers - the thread runs at
 * the lowest of the three application priorities and cannot delay the
 * sampler or the sender.
 *
 * The frame's "timestamp" steps by the accumulated oscillator drift once
 * per interval, so a longer interval means fewer but larger steps. It is
 * never monotonic across a resync either way - see src/frame.c. */
#define NTP_RESYNC_INTERVAL_S 100
#define NTP_RESYNC_PRIORITY   8  /* lower priority than sender (7) and the
				  * sampler on the main thread, so this thread
				  * never preempts either */

/* ---------------- Two-thread architecture for jitter-free 10ms --------
 *
 * Problem: with one thread doing both sampling and network I/O, a single
 * slow TCP round trip (e.g. 25ms Wi-Fi retransmission) delays the NEXT
 * sample too, because frame_build() (src/frame.c) can't run while
 * https_conn_send_frame() (src/https_conn.c) is blocked. The timestamp
 * inside the frame reflects when it was actually built, not when it
 * should have been built - so the server sees jitter.
 *
 * Solution: two threads, one shared buffer, plus the epoch module's own
 * periodic NTP resync thread (src/epoch.c, started via epoch_start_resync()
 * in main() below). CLOCK_REALTIME is independent of
 * sample_timer/sample_tick/frame_ready, so NTP resync never touches this
 * section at all.
 *
 * SAMPLER (main thread, timer-driven, never touches the network):
 *   - k_timer fires every 10ms, gives a semaphore
 *   - main loop takes the semaphore, reads joystick, builds frame
 *   - stores the frame in a shared buffer (protected by a mutex)
 *   - this thread NEVER blocks on network I/O, so the timer cadence
 *     is perfectly maintained regardless of what the network is doing
 *
 * SENDER (dedicated thread, runs as fast as it can):
 *   - waits on a "new frame available" semaphore
 *   - copies the latest frame from the shared buffer
 *   - sends it over HTTPS, waits for response (blocking is fine here -
 *     this thread has nothing else to do, and blocking here doesn't
 *     affect the sampler's timing at all)
 *   - if a send takes 25ms, 2-3 frames were built in the meantime;
 *     the sender picks up the LATEST one, not a stale queued one -
 *     exactly right for a joystick (freshest position matters, not
 *     historical completeness)
 *
 * The server prints the timestamp from INSIDE the frame (board's NTP
 * clock at sample time), not the packet arrival time. Since sampling
 * is now perfectly 10ms-spaced regardless of network conditions, the
 * server output will show clean 10ms intervals even when delivery jitters.
 */

/* Shared frame buffer between sampler and sender threads.
 * shared_frame_len is needed alongside the buffer because JSON frames are
 * variable length - both are protected by the same frame_mutex. */
static uint8_t shared_frame[MAX_FRAME_SIZE];
static size_t shared_frame_len;
static struct k_mutex frame_mutex;
static K_SEM_DEFINE(frame_ready, 0, 1);

/* Timer-driven tick for the sampler */
static K_SEM_DEFINE(sample_tick, 0, 1);

static void sample_timer_handler(struct k_timer *timer)
{
	ARG_UNUSED(timer);
	k_sem_give(&sample_tick);
}

static K_TIMER_DEFINE(sample_timer, sample_timer_handler, NULL);

/* Network sender thread - runs independently, sends latest frame over
 * HTTPS as fast as the network allows. Stack size matches the existing
 * NET_TX_STACK_SIZE since this thread does all the TLS/TCP work. */
#define SENDER_STACK_SIZE 6144
#define SENDER_PRIORITY   7  /* lower priority than main (sampler) so the
			      * sampler always preempts if both are ready.
			      * Higher priority than NTP_RESYNC_PRIORITY (8),
			      * so resync never preempts sending either. */

static void sender_thread_fn(void *p1, void *p2, void *p3)
{
	ARG_UNUSED(p1);
	ARG_UNUSED(p2);
	ARG_UNUSED(p3);

	while (1) {
		/* Block until the sampler signals a new frame is available */
		k_sem_take(&frame_ready, K_FOREVER);

		/* Copy the latest frame under the mutex - hold it as briefly
		 * as possible so the sampler is never blocked waiting on us */
		uint8_t local_frame[MAX_FRAME_SIZE];
		size_t local_frame_len;
		k_mutex_lock(&frame_mutex, K_FOREVER);
		local_frame_len = shared_frame_len;
		memcpy(local_frame, shared_frame, local_frame_len);
		k_mutex_unlock(&frame_mutex);

		/* This is the potentially-slow blocking call. It can take
		 * 5-25ms+ depending on network conditions. Because it runs
		 * on this dedicated thread, not the sampler thread, the
		 * sampler's 10ms timer cadence is completely unaffected. */
		https_conn_send_frame(local_frame, local_frame_len);
	}
}

K_THREAD_STACK_DEFINE(sender_stack, SENDER_STACK_SIZE);

int main(void)
{
#if defined(CLOCK_FEATURE_HFCLK_DIVIDE_PRESENT) || NRF_CLOCK_HAS_HFCLK192M
	/* Run the application core at 128MHz instead of the 64MHz default. */
	nrfx_clock_divider_set(NRF_CLOCK_DOMAIN_HFCLK, NRF_CLOCK_HFCLK_DIV_1);
#endif

	k_sleep(K_SECONDS(1));

	if (joystick_init() != 0) {
		LOG_ERR("X/Y input init failed, halting");
		return 0;
	}

	/* Non-fatal on failure - a missing/misconfigured LED shouldn't
	 * halt telemetry, it's a nice-to-have indicator, not core
	 * functionality. */
	if (led_init() != 0) {
		LOG_WRN("Send-activity LED init failed - continuing without it");
	}

	/* Non-fatal on failure: the DK buttons only feed the button_up /
	 * button_down fields of each frame (src/button_inputs.h). A button
	 * that cannot be read simply reports 0 (not pressed); telemetry
	 * itself does not depend on it. */
	if (button_inputs_init() != 0) {
		LOG_WRN("Button state inputs init failed - affected button(s) "
			"will report 0 in every frame");
	}

#ifdef CONFIG_SEND_TRIGGER_NEEDS_BUTTON
	/* FATAL on failure, unlike the LED above, and deliberately so. The
	 * LED is an indicator the board works fine without; this button is
	 * the ONLY thing that can trigger a send. Both accessors fail safe to
	 * "no send" (see src/button.h), so carrying on after a failed init
	 * would leave the board powered, associated, and permanently silent -
	 * a fault that looks identical to a network problem and would cost
	 * real time to diagnose. Halt and say why. */
	if (button_init() != 0) {
		LOG_ERR("Send-trigger button init failed, halting - this build "
			"cannot transmit without it (see SEND_TRIGGER in Kconfig)");
		return 0;
	}
#endif

	/* Calibrate the joystick's true center point now, while it's
	 * expected to still be at rest (before Wi-Fi/TLS setup below, which
	 * gives the person plenty of time to have let go of it if they were
	 * testing it during flashing). See src/joystick.c for why this
	 * replaced a hardcoded theoretical center. */
	joystick_calibrate_center();

	if (https_conn_provision_cert() != 0) {
		LOG_ERR("Cert provisioning failed, halting");
		return 0;
	}

	/* Registers the Wi-Fi/DHCP event callbacks, connects, and blocks
	 * until both Wi-Fi is associated and a DHCP lease is bound (or their
	 * respective timeouts elapse) - see src/wifi_net.c for the full
	 * sequence and the specific error already logged on failure. */
	if (wifi_net_connect_and_wait() != 0) {
		return 0;
	}

	k_sleep(K_SECONDS(3)); /* let association settle before TLS/NTP */

	/* Initial NTP sync happens over plain UDP (no TLS) to the same PC.
	 * If it fails, we log it and carry on - CLOCK_REALTIME will just
	 * stay at epoch 0 (1970-01-01) until the periodic resync thread
	 * (started below) succeeds. */
	if (epoch_sync_now(NTP_SERVER) != 0) {
		LOG_WRN("Continuing without NTP - CLOCK_REALTIME will read epoch-0 "
			"(1970-01-01) until periodic resync succeeds");
	}

	/* Resolves "verdin-imx8mp.local" over mDNS and then opens the TLS +
	 * WebSocket connection. This BLOCKS until both succeed, retrying
	 * every 5 s - see https_conn_open() in src/https_conn.h. The old
	 * "halting" path below can no longer be reached, and is kept only so
	 * that a future bounded variant of https_conn_open() still has a
	 * failure branch here. */
	if (https_conn_open() != 0) {
		LOG_ERR("TLS setup failed, halting");
		return 0;
	}

	/* Prints the ACTUAL period rather than a hardcoded number - replay
	 * builds set it from Kconfig, so a literal here would drift. */
#if defined(CONFIG_SEND_TRIGGER_BUTTON_PRESS)
	LOG_INF("Setup complete - %d ms sampler, ONE FRAME PER PRESS of "
		"Button 1 (two-thread + NTP resync). PRESS Button 1 to send.",
		SEND_PERIOD_MS);
#elif defined(CONFIG_SEND_TRIGGER_BUTTON_HOLD)
	LOG_INF("Setup complete - %d ms X/Y send loop, GATED on Button 1 "
		"(two-thread + NTP resync). HOLD Button 1 to transmit.",
		SEND_PERIOD_MS);
#else
	LOG_INF("Setup complete - entering %d ms X/Y send loop "
		"(two-thread + NTP resync)", SEND_PERIOD_MS);
#endif

	/* Initialise the shared frame mutex */
	k_mutex_init(&frame_mutex);

	/* Start the sender thread BEFORE the timer, so it's ready and
	 * waiting on frame_ready before the first frame is built. */
	static struct k_thread sender_thread_data;
	k_thread_create(&sender_thread_data, sender_stack,
			K_THREAD_STACK_SIZEOF(sender_stack),
			sender_thread_fn, NULL, NULL, NULL,
			SENDER_PRIORITY, 0, K_NO_WAIT);
	k_thread_name_set(&sender_thread_data, "https_sender");

	/* Start the epoch module's periodic NTP resync thread. Lowest
	 * priority of the three application threads (sampler > sender >
	 * resync), so it can never delay a sample or a send - it only ever
	 * runs when both of those are idle/blocked. */
	epoch_start_resync(NTP_SERVER, NTP_RESYNC_INTERVAL_S, NTP_RESYNC_PRIORITY);

	/* Start the sampling timer */
	k_timer_start(&sample_timer, K_MSEC(SEND_PERIOD_MS), K_MSEC(SEND_PERIOD_MS));

	/* Sampler loop: runs on the main thread, timer-driven, NEVER touches
	 * the network. Reads joystick, builds frame, stores it for the sender
	 * thread to pick up. This loop's timing is completely independent of
	 * network conditions - even if a TCP round trip takes 100ms, this
	 * loop keeps sampling at exactly SEND_PERIOD_MS intervals. */
	while (1) {
		k_sem_take(&sample_tick, K_FOREVER);

		/* Sampled on EVERY tick, gated or not. Two reasons this sits
		 * above the gate rather than below it:
		 *   - joystick.c's current_x_state/current_y_state stay fresh,
		 *     so the first frame after a press carries a reading taken
		 *     at most one tick ago instead of one from whenever the
		 *     button was last released.
		 *   - the ADC debug logging in joystick.c keeps running while
		 *     the gate is shut, which is what makes this build usable
		 *     for the open joystick-wiring investigation.
		 * It costs two ADC reads per tick while idle - cheap, and the
		 * timer is running anyway. */
		joystick_sample();

#ifdef CONFIG_SEND_TRIGGER_NEEDS_BUTTON
		/* ---------------- Send trigger ----------------
		 *
		 * Placed AFTER joystick_sample() and BEFORE frame_build() on
		 * purpose. frame_build() is what increments the sequence
		 * number and (in replay builds) advances the replay row, so
		 * skipping it here PAUSES the trajectory rather than skipping
		 * through it - the recorded pass stays complete and in order
		 * across any number of presses. See SEND_TRIGGER_NEEDS_BUTTON
		 * in Kconfig for the one case where that is still not enough.
		 *
		 * Polled once per tick rather than ISR-driven, and debounced
		 * inside button.c - see src/button.h for why both of those are
		 * the right call for a button that gates transmission. */
		button_poll();
#endif

#if defined(CONFIG_SEND_TRIGGER_BUTTON_PRESS)
		/* ONE frame per press. button_take_press() consumes the latch,
		 * so a held button sends exactly one frame and then nothing
		 * until it is released and pressed again.
		 *
		 * No k_sem_reset() of frame_ready here, unlike the hold mode
		 * below: there is no stream to cut short, and resetting could
		 * discard the single frame this press just asked for. */
		if (!button_take_press()) {
			continue; /* no press this tick - build nothing */
		}

		/* Logged per press. Cheap at human press rates, and it is the
		 * only confirmation the press registered when the resulting
		 * frame fails to send for some unrelated reason. */
		LOG_INF("Button 1 pressed - sending one frame");

#elif defined(CONFIG_SEND_TRIGGER_BUTTON_HOLD)
		/* Stream while held. */
		{
			/* static: must survive across iterations, since the
			 * point is comparing this tick against the last.
			 * Only ever touched by this thread. */
			static bool was_held;
			bool is_held = button_is_held();

			if (is_held != was_held) {
				/* Logged on the EDGE only, never per tick. At
				 * 50 Hz a per-tick line would add ~60 chars of
				 * UART per frame and the console is already at
				 * roughly 100 % utilisation in a replay build. */
				LOG_INF("Send gate %s (Button 1 %s)",
					is_held ? "OPEN - streaming" : "SHUT - idle",
					is_held ? "pressed" : "released");

				if (!is_held) {
					/* Falling edge: drop a frame already
					 * signalled but not yet picked up, so
					 * "release stops the stream" is literally
					 * true rather than true-plus-one-frame.
					 *
					 * A send ALREADY in flight still
					 * completes - the sender thread is
					 * blocked inside zsock_send() and there
					 * is no safe way to unwind that. Expect
					 * at most one more frame after release,
					 * not zero. */
					k_sem_reset(&frame_ready);
				}

				was_held = is_held;
			}

			if (!is_held) {
				continue; /* gate shut - build nothing */
			}
		}
#endif

		uint8_t frame[MAX_FRAME_SIZE];
		size_t frame_len = frame_build(frame);

		/* Store the freshly-built frame in the shared buffer. The
		 * mutex is held for just a memcpy (~nanoseconds), so the
		 * sender thread is never meaningfully blocked by this. */
		k_mutex_lock(&frame_mutex, K_FOREVER);
		memcpy(shared_frame, frame, frame_len);
		shared_frame_len = frame_len;
		k_mutex_unlock(&frame_mutex);

		/* Signal the sender thread that a new frame is available.
		 * k_sem_give with max count 1 means: if the sender hasn't
		 * picked up the previous frame yet (still blocked on the
		 * network), this just overwrites it - the sender will get
		 * the LATEST frame when it's ready, not a stale queued one.
		 * Exactly right for a joystick controller. */
		k_sem_give(&frame_ready);
	}

	return 0;
}
```

## src/button_inputs.c
```c
#include "button_inputs.h"

#include <zephyr/logging/log.h>
LOG_MODULE_REGISTER(button_inputs, CONFIG_LOG_DEFAULT_LEVEL);

#include <zephyr/drivers/gpio.h>
#include <stdbool.h>
#include <errno.h>

/* Both aliases ship with the nRF7002 DK board support, so no app.overlay
 * entry is needed (same pattern as src/led.c and src/button.c). */
static const struct gpio_dt_spec button1_spec = GPIO_DT_SPEC_GET(DT_ALIAS(sw0), gpios);
static const struct gpio_dt_spec button2_spec = GPIO_DT_SPEC_GET(DT_ALIAS(sw1), gpios);

/* Set only after the pin was configured successfully. Without it a read
 * before init (or after a failed init) would sample an unconfigured pad,
 * whose value is whatever it powered up as; this makes it report 0. */
static bool button1_ready;
static bool button2_ready;

/* Configures one pin as an input. GPIO_INPUT only: the pull-up and the
 * active-low polarity both come from the board devicetree flags and
 * gpio_pin_configure_dt() ORs them in, so restating them here would be
 * redundant. Returns 0 on success. */
static int configure_input(const struct gpio_dt_spec *spec, const char *name)
{
	int ret;

	if (!gpio_is_ready_dt(spec)) {
		LOG_ERR("%s GPIO device not ready", name);
		return -ENODEV;
	}

	ret = gpio_pin_configure_dt(spec, GPIO_INPUT);
	if (ret) {
		LOG_ERR("Failed to configure %s (%d)", name, ret);
	}
	return ret;
}

int button_inputs_init(void)
{
	int ret1 = configure_input(&button1_spec, "Button 1 (sw0 / P1.08)");
	int ret2 = configure_input(&button2_spec, "Button 2 (sw1 / P1.09)");

	button1_ready = (ret1 == 0);
	button2_ready = (ret2 == 0);

	if (button1_ready && button2_ready) {
		LOG_INF("Button state inputs ready: Button 1 (P1.08), Button 2 (P1.09)");
	}

	return ret1 ? ret1 : ret2;
}

/* Logical level of one pin: 1 = pressed. A negative gpio_pin_get_dt()
 * result is a read error and is reported as "not pressed" rather than
 * propagated - a button state is not worth failing a frame over. */
static uint8_t read_pressed(const struct gpio_dt_spec *spec, bool ready)
{
	int val;

	if (!ready) {
		return 0;
	}

	val = gpio_pin_get_dt(spec);
	return (val > 0) ? 1 : 0;
}

void button_inputs_read(uint8_t *button1, uint8_t *button2)
{
	if (button1) {
		*button1 = read_pressed(&button1_spec, button1_ready);
	}
	if (button2) {
		*button2 = read_pressed(&button2_spec, button2_ready);
	}
}
```

## src/client_certs.h
```c
/* Generated by gen_cert_arrays.py - paste into main.c, near ca_certificate[] */

static const unsigned char client_certificate[] =
"-----BEGIN CERTIFICATE-----\n"
"MIIB4TCCAYegAwIBAgIUcr5kCGAik1CjFmdxeKj6KIWIe9UwCgYIKoZIzj0EAwIw\n"
"QDELMAkGA1UEBhMCSU4xETAPBgNVBAoMCFBpbmV0aWNzMR4wHAYDVQQDDBVQaW5l\n"
"dGljcyBUZXN0IFJvb3QgQ0EwHhcNMjYwODI2MDcwNTIyWhcNMzYwODIzMDcwNTIy\n"
"WjA4MQswCQYDVQQGEwJJTjERMA8GA1UECgwIUGluZXRpY3MxFjAUBgNVBAMMDU5S\n"
"RjcwMDItREstMDEwWTATBgcqhkjOPQIBBggqhkjOPQMBBwNCAAQ7PTLjOXovVKEw\n"
"L+z5mj8eoP8BRsD49P3jtxaaW16lkROZQkc+zFitP254+0gX4eiHYOcbEOGRYimu\n"
"Agh87aCQo2cwZTATBgNVHSUEDDAKBggrBgEFBQcDAjAOBgNVHQ8BAf8EBAMCB4Aw\n"
"HQYDVR0OBBYEFO0WcGnK4nP4ZOIn9WjlBBtjeMBdMB8GA1UdIwQYMBaAFMHV3wuO\n"
"v6K5UCpwLRqyJR4NrRnlMAoGCCqGSM49BAMCA0gAMEUCIHsS0RWq5Om0BLPmM3yx\n"
"LQgyAi/r540C67cPd/qGK4ikAiEAr4LcXLQqHHbrvZGWCssjK3sA3KUCFjZtdvnl\n"
"bWAij20=\n"
"-----END CERTIFICATE-----\n";

static const unsigned char client_private_key[] =
"-----BEGIN EC PRIVATE KEY-----\n"
"MHcCAQEEIDZVgM7u4Z3A7rAlktXjbjGJFSte54To9R10G9cDgvdFoAoGCCqGSM49\n"
"AwEHoUQDQgAEOz0y4zl6L1ShMC/s+Zo/HqD/AUbA+PT947cWmltepZETmUJHPsxY\n"
"rT9uePtIF+Hoh2DnGxDhkWIprgIIfO2gkA==\n"
"-----END EC PRIVATE KEY-----\n";
```

## src/epoch.c
```c
#include "epoch.h"

#include <zephyr/logging/log.h>
LOG_MODULE_REGISTER(epoch, CONFIG_LOG_DEFAULT_LEVEL);

#include <zephyr/kernel.h>
#include <zephyr/net/sntp.h>
#include <stdbool.h>
#include <stdio.h>
#include <time.h>

#define NTP_SYNC_TIMEOUT_MS 5000
#define RESYNC_STACK_SIZE    2048

static bool ntp_ever_synced;

/* Raw NTP server timestamp from the most recent successful sync, captured
 * directly from struct sntp_time as returned by sntp_simple() - NOT
 * derived from CLOCK_REALTIME/epoch_now_ms(). This is the literal value
 * the NTP server sent us, held as-is until the next sync updates it.
 * Protected by ntp_value_mutex since it's written on whichever thread
 * calls epoch_sync_now() (both the caller's initial sync and the resync
 * thread below) and read via epoch_get_last_ntp() from other threads. */
static uint64_t last_ntp_seconds;
static uint32_t last_ntp_fraction;
static K_MUTEX_DEFINE(ntp_value_mutex);

int epoch_sync_now(const char *server_addr)
{
	struct sntp_time ts;
	struct timespec real_ts;
	int ret;

	ret = sntp_simple(server_addr, NTP_SYNC_TIMEOUT_MS, &ts);
	if (ret) {
		LOG_ERR("NTP sync with %s failed (%d) - CLOCK_REALTIME left "
			"unchanged (or still epoch-0 if never synced)",
			server_addr, ret);
		return ret;
	}

	/* Store the raw server timestamp unconditionally right after a
	 * successful sntp_simple() call, before anything else, so it's
	 * exactly what the server sent. */
	k_mutex_lock(&ntp_value_mutex, K_FOREVER);
	last_ntp_seconds = ts.seconds;
	last_ntp_fraction = ts.fraction;
	k_mutex_unlock(&ntp_value_mutex);

	/* ts.seconds is unix epoch seconds (Zephyr's sntp_simple() already
	 * converts from the NTP 1900 epoch). ts.fraction is a Q32 fixed-point
	 * fraction of a second (fraction / 2^32 = fractional seconds) -
	 * convert that to nanoseconds for struct timespec. */
	real_ts.tv_sec  = (time_t)ts.seconds;
	real_ts.tv_nsec = (long)(((uint64_t)ts.fraction * 1000000000ULL) >> 32);

	ret = clock_settime(CLOCK_REALTIME, &real_ts);
	if (ret) {
		LOG_ERR("clock_settime(CLOCK_REALTIME) failed (%d) - "
			"CONFIG_POSIX_CLOCK may not be enabled in prj.conf", ret);
		return ret;
	}

	if (ntp_ever_synced) {
		LOG_INF("NTP resync OK: epoch=%llu.%09ld sec (from %s)",
			(unsigned long long)real_ts.tv_sec, real_ts.tv_nsec,
			server_addr);
	} else {
		LOG_INF("NTP initial sync OK: epoch=%llu.%09ld sec (from %s)",
			(unsigned long long)real_ts.tv_sec, real_ts.tv_nsec,
			server_addr);
		ntp_ever_synced = true;
	}

	return 0;
}

uint64_t epoch_now_ms(void)
{
	struct timespec ts;

	if (clock_gettime(CLOCK_REALTIME, &ts) != 0) {
		/* Should not normally happen; fall back to raw uptime so the
		 * caller never stalls even if this somehow fails. */
		return (uint64_t)k_uptime_get();
	}

	return (uint64_t)ts.tv_sec * 1000ULL + (uint64_t)(ts.tv_nsec / 1000000L);
}

void epoch_format(uint64_t epoch_ms, char *buf, size_t buf_len)
{
	time_t sec = (time_t)(epoch_ms / 1000);
	uint32_t ms = (uint32_t)(epoch_ms % 1000);
	struct tm tm_val;

	gmtime_r(&sec, &tm_val);
	snprintf(buf, buf_len, "%04d-%02d-%02d %02d:%02d:%02d.%03u",
		 tm_val.tm_year + 1900, tm_val.tm_mon + 1, tm_val.tm_mday,
		 tm_val.tm_hour, tm_val.tm_min, tm_val.tm_sec, ms);
}

void epoch_get_last_ntp(uint64_t *seconds, uint32_t *fraction)
{
	k_mutex_lock(&ntp_value_mutex, K_FOREVER);
	*seconds = last_ntp_seconds;
	*fraction = last_ntp_fraction;
	k_mutex_unlock(&ntp_value_mutex);
}

/* ---------------- Periodic resync thread ----------------
 * Wakes up every interval_s seconds and re-queries server_addr, pushing
 * the result into CLOCK_REALTIME via epoch_sync_now(). Its only shared
 * state is CLOCK_REALTIME itself (via the kernel's own clock_settime())
 * and ntp_value_mutex above - no coupling to any other application state,
 * so it has no effect on whatever else the caller's other threads do. */
struct resync_args {
	const char *server_addr;
	uint32_t interval_s;
};

static void resync_thread_fn(void *p1, void *p2, void *p3)
{
	const struct resync_args *args = p1;

	ARG_UNUSED(p2);
	ARG_UNUSED(p3);

	while (1) {
		k_sleep(K_SECONDS(args->interval_s));

		/* Blocking network I/O happens here, on this dedicated
		 * thread only. Failure just logs and leaves CLOCK_REALTIME
		 * as-is. */
		(void)epoch_sync_now(args->server_addr);
	}
}

K_THREAD_STACK_DEFINE(resync_stack, RESYNC_STACK_SIZE);

void epoch_start_resync(const char *server_addr, uint32_t interval_s, int priority)
{
	static struct k_thread resync_thread_data;
	/* static: the thread reads this for its entire lifetime, so it must
	 * outlive this function call. */
	static struct resync_args args;

	args.server_addr = server_addr;
	args.interval_s = interval_s;

	k_thread_create(&resync_thread_data, resync_stack,
			K_THREAD_STACK_SIZEOF(resync_stack),
			resync_thread_fn, &args, NULL, NULL,
			priority, 0, K_NO_WAIT);
	k_thread_name_set(&resync_thread_data, "epoch_resync");
}
```

## src/led.h
```c
#ifndef LED_H_
#define LED_H_

/* Send-activity LED: blinks the board's LED0 for the duration of each
 * frame send, so there's a visible heartbeat that data is actually going
 * out - useful at a glance without needing to watch the serial log. */

/* Sets up the LED GPIO. Call once at boot. Returns 0 on success. Failure
 * here is meant to be treated as non-fatal by the caller - a missing LED
 * shouldn't halt telemetry, it's a nice-to-have indicator. */
int led_init(void);

/* Turns the send-activity LED on / off. Safe to call even if led_init()
 * was never called or failed - the underlying GPIO call is simply a
 * no-op/error in that case. */
void led_on(void);
void led_off(void);

#endif /* LED_H_ */
```
